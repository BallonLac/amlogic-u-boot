## configs/bananapi_m5_defconfig
```kconfig
CONFIG_ARM=y
CONFIG_TARGET_MESON_G12A=y
CONFIG_BANANAPI_M5=y
CONFIG_DM=y
CONFIG_DM_GPIO=y
CONFIG_AML_GPIO=y
CONFIG_OF_LIBFDT_OVERLAY=y
CONFIG_USB_XHCI_AMLOGIC_V2=y
```
